## main/Kconfig.projbuild
```kconfig
menu "Unit test"
	config UNIT_TEST_MODE
		bool  "Change to unit test mode"
		default n
		help
			Change compilation to the unit test mode.
			It needs to connect via the built-in serial interface.
endmenu
menu "Motor Controller Firmware configuration"
	config FIRMWARE_TICK_INTERVAL
		int "Firmware tick interval (ms)"
		range 10 1000
		default 50
		help
			Time interval between firmware ticks.
			This controls the frecuency by wich Controller.loop is called.
	config SENSOR_SAMPLE_TIME
		int "Sensor sample time (ms)"
		range 1 100
		default 5
		help
			The sample time, in miliseconds, for sampling the sensors.
endmenu
menu "Motor Controller Configuration"
	config SINE_WAVE_SAMPLE_TIMEus
		int "Sine wave sample time (us)"
		range 100 500
		default 200
		help
			The sample time of the generated sine wave.
			This value influences the "graininess" of the output signal and the maximum frecuency that the controller can generate.
			A value of 100us corresponds to about a maximum frecuency of 1.25kHz, while a value of 500us yields a maximum frecuency of 250Hz
endmenu
```
